## main/Kconfig.projbuild
```kconfig
menu "APC NUT Server Configuration"

    choice APC_NUT_BOARD
        prompt "Target board"
        default APC_NUT_BOARD_ESP32P4_ETH
        help
            Select the hardware platform.

        config APC_NUT_BOARD_ESP32S3
            bool "ESP32-S3 (WiFi)"
            help
                Generic ESP32-S3 board using WiFi for networking.

        config APC_NUT_BOARD_ESP32P4_ETH
            bool "Waveshare ESP32-P4-ETH (wired Ethernet)"
            help
                Waveshare ESP32-P4-ETH board with IP101 GRI PHY via RMII.
    endchoice

    if APC_NUT_BOARD_ESP32S3
        config APC_NUT_WIFI_SSID
            string "WiFi SSID"
            default "myssid"
            help
                SSID of the WiFi network to connect to.

        config APC_NUT_WIFI_PASSWORD
            string "WiFi Password"
            default "mypassword"
            help
                WiFi password.
    endif

    config APC_NUT_PORT
        int "NUT TCP port"
        default 3493
        range 1 65535
        help
            TCP port the NUT server listens on (standard NUT port is 3493).

    config APC_NUT_USERNAME
        string "NUT username"
        default "upsmon"
        help
            Username accepted for NUT LOGIN command.

    config APC_NUT_PASSWORD
        string "NUT password"
        default "secret"
        help
            Password accepted for NUT LOGIN command.

    config APC_UPS_POLL_INTERVAL_MS
        int "UPS poll interval (ms)"
        default 2000
        range 500 30000
        help
            How often to query the UPS via USB HID GET_REPORT.

    config APC_HID_DEBUG
        bool "Enable HID descriptor dump on connect"
        default y
        help
            On first USB connect, dump the full parsed HID descriptor to the
            serial console. Useful for verifying field mappings on a new device.
            Disable in production to reduce log noise.

endmenu
```

## sdkconfig.defaults
```kconfig
CONFIG_IDF_TARGET="esp32p4"
CONFIG_ESP32P4_SELECTS_REV_LESS_V3=y
CONFIG_ESP32P4_REV_MIN_100=y
CONFIG_ESPTOOLPY_FLASHSIZE_16MB=y
CONFIG_ESPTOOLPY_FLASHSIZE="16MB"
CONFIG_PARTITION_TABLE_CUSTOM=y
CONFIG_PARTITION_TABLE_CUSTOM_FILENAME="partitions.csv"
CONFIG_USB_OTG_SUPPORTED=y
CONFIG_USB_HOST_CONTROL_TRANSFER_MAX_SIZE=2048
CONFIG_ETH_ENABLED=y
CONFIG_ETH_USE_ESP32_EMAC=y
CONFIG_ETH_PHY_IP101=y
CONFIG_LWIP_MAX_SOCKETS=16
CONFIG_LWIP_SOCKET_SELECT_FUNC=y
CONFIG_ESP_MAIN_TASK_STACK_SIZE=8192
CONFIG_FREERTOS_HZ=1000
CONFIG_LOG_DEFAULT_LEVEL_INFO=y
CONFIG_LWIP_TCPIP_TASK_STACK_SIZE=8192
CONFIG_BOOTLOADER_APP_ROLLBACK_ENABLE=y
```
